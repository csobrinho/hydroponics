## components/hydroponics-context/Kconfig.projbuild
```kconfig
menu "Project config"
    menu "Syslog"
        config ESP_SYSLOG_ENABLE
            bool "Enable"

        config ESP_SYSLOG_IPV4_ADDR
            string "IPV4 Address"
            default "255.255.255.255"
            depends on ESP_SYSLOG_ENABLE
            help
                IPV4 address to which the syslog client will send data.

        config ESP_SYSLOG_PORT
            int "Port"
            range 0 65535
            default 514
            depends on ESP_SYSLOG_ENABLE
            help
                The remote port to which the syslog client will send data.

    endmenu

    menu "Sensors"
        config ESP_SENSOR_TANKS
            int "Number of tanks"
            default 1
            range 1 2
            help
                Set the number of tanks.
    endmenu

endmenu
```

## components/hydroponics-lcd-dev-st7796s/Kconfig
```kconfig
menu "LCD ST7796S"
    depends on ESP_LCD_ST7796S
    config ESP_LCD_ST7796S_CLOCK
        int "LCD SPI Clock (MHz)"
        default 80
endmenu
```

## components/hydroponics-lcd-spi/Kconfig
```kconfig
config ESP_LCD_SPI
    bool

menu "LCD SPI"
    depends on ESP_LCD_SPI
    config ESP_LCD_SPI_MISO
        int "MISO"
        range 0 39
        default 37 if IDF_TARGET_ESP32
        default 13 if IDF_TARGET_ESP32S2
    config ESP_LCD_SPI_MOSI
        int "MOSI"
        range 0 39
        default 35 if IDF_TARGET_ESP32
        default 11 if IDF_TARGET_ESP32S2
    config ESP_LCD_SPI_SCK
        int "SCK"
        range 0 39
        default 36 if IDF_TARGET_ESP32
        default 12 if IDF_TARGET_ESP32S2
    config ESP_LCD_SPI_CS
        int "CS"
        range 0 39
        default 34 if IDF_TARGET_ESP32
        default 10 if IDF_TARGET_ESP32S2
    config ESP_LCD_SPI_DC
        int "DC"
        range 0 39
        default 4
    config ESP_LCD_SPI_RST
        int "RST"
        range 0 39
        default 5
    config ESP_LCD_SPI_LED
        int "LED"
        range 0 39
        default 6
endmenu
```

## main/Kconfig.projbuild
```kconfig
# put here your custom config value
menu "Project config"
    config BLINK_GPIO
        int "Blink GPIO number"
        range 0 34
        default 25
        help
            GPIO number (IOxx) to blink on and off.
            Some GPIOs are used for other purposes (flash connections, etc.) and cannot be used to blink.
            GPIOs 35-39 are input-only so cannot be used as outputs.

    config ESP_WIFI_SSID
        string "WiFi SSID"
        default ""
        help
            SSID (network name) for the example to connect to.

    config ESP_WIFI_PASSWORD
        string "WiFi Password"
        default ""
        help
            WiFi password (WPA or WPA2) for the example to use.

    config ESP_MAXIMUM_RETRY
        int "Maximum retry"
        default 5
        help
            Set the Maximum retry to avoid station reconnecting to the AP unlimited when the AP is really inexistent.

    config ESP_ONE_WIRE_GPIO
        int "OneWire GPIO number"
        range 0 34
        default 22
        help
            GPIO number (IOxx) to access One Wire Bus.
            Some GPIOs are used for other purposes (flash connections, etc.) and cannot be used.
            GPIOs 35-39 are input-only so cannot be used to drive the One Wire Bus.

    menu "Syslog"
        config ESP_SYSLOG_ENABLE
            bool "Enable"

        config ESP_SYSLOG_IPV4_ADDR
            string "IPV4 Address"
            default "255.255.255.255"
            depends on ESP_SYSLOG_ENABLE
            help
                IPV4 address to which the syslog client will send data.

        config ESP_SYSLOG_PORT
            int "Port"
            range 0 65535
            default 514
            depends on ESP_SYSLOG_ENABLE
            help
                The remote port to which the syslog client will send data.

    endmenu

    menu "Sampling"
        config ESP_SAMPLING_HUMIDITY_MS
            int "Humidity"
            default 1000
            help
                Set the sampling rate for humidity/outdoor temperature readings in ms.

        config ESP_SAMPLING_TEMPERATURE_MS
            int "Temperature"
            default 1000
            help
                Set the sampling rate for water temperature readings in ms.

        config ESP_SAMPLING_TANK_MS
            int "Tank"
            default 2000
            help
                Set the sampling rate for the tank levels in ms.

        config ESP_SAMPLING_EC_MS
            int "EC Probe"
            default 1500
            help
                Set the sampling rate for electrical conductivity (EC) probe readings in ms.

        config ESP_SAMPLING_RTD_MS
            int "EC Probe (temperature)"
            default 1000
            help
                Set the sampling rate for the RTD readings in ms inside the electrical conductivity (EC) probe.

        config ESP_SAMPLING_PH_MS
            int "PH Probe"
            default 1500
            help
                Set the sampling rate for PH probe readings in ms.

    endmenu

    menu "Sensors"
        config ESP_SENSOR_TANKS
            int "Number of tanks"
            default 2
            range 1 2
            help
                Set the number of tanks.

        config ESP_SENSOR_RTD_ADDR
            hex "RTD Probe I2C Address"
            default 0x66
            range 0x00 0xff
            help
                Set the RTD probe I2C address.

        config ESP_SENSOR_EC_TANK_A_ADDR
            hex "Tank A EC Probe I2C Address"
            default 0x64
            range 0x00 0xff
            help
                Set the tank A EC probe I2C address.

        config ESP_SENSOR_EC_TANK_B_ADDR
            hex "Tank B EC Probe I2C Address"
            default 0x74
            range 0x00 0xff
            help
                Set the tank B EC probe I2C address.

        config ESP_SENSOR_PH_TANK_A_ADDR
            hex "Tank A PH Probe I2C Address"
            default 0x63
            range 0x00 0xff
            help
                Set the tank A PH probe I2C address.

        config ESP_SENSOR_PH_TANK_B_ADDR
            hex "Tank B PH Probe I2C Address"
            default 0x73
            range 0x00 0xff
            help
                Set the tank B PH probe I2C address.

        config ESP_SENSOR_SIMULATE
            bool "Simulate the sensors"
            default n
            help
                Simulate the sensor data instead of using the real hardware.
    endmenu
endmenu

menu "IoT Solution settings"
    # Copied from the esp-iot-solution main kconfig file.
        menu "I2S devices"
            choice LCD_BITEMODE_CHOOSE
                bool "Choose Bit Mode"
                    default BIT_MODE_16BIT

                config BIT_MODE_16BIT
                    bool "16_BIT_MODE"
                config BIT_MODE_8BIT
                    bool "8_BIT_MODE"

            endchoice
        endmenu
endmenu
```

## sdkconfig.defaults
```kconfig
# ESP32 general network config.
CONFIG_ETH_ENABLED=n
CONFIG_ETH_USE_ESP32_EMAC=n
CONFIG_ETH_USE_SPI_ETHERNET=n
CONFIG_ESP_NETIF_TCPIP_ADAPTER_COMPATIBLE_LAYER=n
CONFIG_LWIP_DHCP_RESTORE_LAST_IP=y

# Google IoT Core config.
CONFIG_GIOT_PROJECT_ID="iot-hydroponics"
CONFIG_GIOT_LOCATION="us-central1"
CONFIG_GIOT_REGISTRY_ID="registry"

# LCD mode.
CONFIG_BIT_MODE_8BIT=y

# Enable logs dumping via UDP broadcast.
CONFIG_ESP_SYSLOG_ENABLE=y

# FreeRtos options.
CONFIG_FREERTOS_USE_TRACE_FACILITY=y
CONFIG_FREERTOS_VTASKLIST_INCLUDE_COREID=y
CONFIG_FREERTOS_GENERATE_RUN_TIME_STATS=y

# Stack overflows and memory corruptions.
CONFIG_FREERTOS_WATCHPOINT_END_OF_STACK=y
CONFIG_HEAP_POISONING_COMPREHENSIVE=y
CONFIG_HEAP_TASK_TRACKING=y
CONFIG_COMPILER_STACK_CHECK=y
CONFIG_COMPILER_WARN_WRITE_STRINGS=y
CONFIG_COMPILER_STACK_CHECK_MODE_NORM=y

# Use a custom and bigger partition.
CONFIG_PARTITION_TABLE_CUSTOM=y
CONFIG_PARTITION_TABLE_CUSTOM_FILENAME="main/partitions.csv"
CONFIG_PARTITION_TABLE_FILENAME="main/partitions.csv"
```

## sdkconfig.defaults.esp32
```kconfig
CONFIG_ESP32_DEFAULT_CPU_FREQ_240=y
CONFIG_ESP32_DEFAULT_CPU_FREQ_MHZ=240
CONFIG_ESPTOOLPY_FLASHSIZE_8MB=y
CONFIG_ESP32_XTAL_FREQ_26=y
CONFIG_ESP32_XTAL_FREQ=26
CONFIG_GIOT_DEVICE_ID="GreenMeanMachine"
CONFIG_LWIP_LOCAL_HOSTNAME="hydroponics"
```

## sdkconfig.defaults.esp32s2
```kconfig
CONFIG_ESP32S2_DEFAULT_CPU_FREQ_240=y
CONFIG_ESP32S2_DEFAULT_CPU_FREQ_MHZ=240
CONFIG_ESPTOOLPY_FLASHSIZE_4MB=y
CONFIG_GIOT_DEVICE_ID="GreenMeanMachine-test"
CONFIG_LWIP_LOCAL_HOSTNAME="hydroponics-test"
CONFIG_ESP_SIMULATE_SENSORS=y

CONFIG_SPIRAM_SUPPORT=y
CONFIG_SPIRAM_TYPE_AUTO=y
CONFIG_SPIRAM_SIZE=-1
CONFIG_SPIRAM=y
CONFIG_SPIRAM_BOOT_INIT=y

# OpenOCD
CONFIG_ESP32S2_DEBUG_OCDAWARE=y
```

## sdkconfig.defaults.esp32s3
```kconfig
CONFIG_ESP32S2_DEFAULT_CPU_FREQ_240=y
CONFIG_ESP32S2_DEFAULT_CPU_FREQ_MHZ=240
CONFIG_ESPTOOLPY_FLASHSIZE_16MB=y
CONFIG_GIOT_DEVICE_ID="GreenMeanMachine-test"
CONFIG_LWIP_LOCAL_HOSTNAME="GreenMeanMachine-test"
CONFIG_ESP_SYSLOG_PORT=513
CONFIG_ESP_SENSOR_SIMULATE=y

# Coredump and crashed,
CONFIG_ESP_COREDUMP_ENABLE=y
CONFIG_ESP_COREDUMP_ENABLE_TO_UART=y

# OpenOCD.
CONFIG_ESP32S2_DEBUG_OCDAWARE=y
CONFIG_ESP32S2_DEBUG_STUBS_ENABLE=y
```
